## CMakeLists.txt
```
set(ENV{EXTRA_ZEPHYR_MODULES}
    "/home/niall/csse4011/repo/mycode/p2/t2/mylib_sensors"
)

cmake_minimum_required(VERSION 3.20.0)
find_package(Zephyr REQUIRED HINTS $ENV{ZEPHYR_BASE})
project(mylib_sensors-tapp)

FILE(GLOB tapp_sources src/*.c)
target_sources(app PRIVATE ${tapp_sources})
```

## prj.conf
```kconfig
# CONFIG_CONSOLE=y
# CONFIG_UART_CONSOLE=y
# CONFIG_STDOUT_CONSOLE=y     

# CONFIG_PRINTK=y
# CONFIG_LOG_PRINTK=y

# CONFIG_I2C_DUMP_MESSAGES=y

# CONFIG_GPIO=y

# CONFIG_SENSOR=y
# CONFIG_SI7006=y
# CONFIG_CCS811=y
# CONFIG_BME280=y

# CONFIG_I2C=y

# CONFIG_I2C_LOG_LEVEL_DBG=y

CONFIG_MYLIB_SENSORS=y
```

## src/main.c
```c
#include "zephyr/drivers/sensor.h"
#include <mylib_sensors_bmp280.h>
#include <mylib_sensors_si7021.h>
#include <mylib_sensors_si1133.h>

#include <zephyr/kernel.h>

#include <zephyr/drivers/sensor.h>

static const struct device* si1133dev = DEVICE_DT_GET(DT_NODELABEL(si1133));

int main(void)
{
    while (1) {

        struct sensor_q31_data bmp280_temp_data;
        bmp280_get_temp_data(&bmp280_temp_data);
        bmp280_printk_temp(&bmp280_temp_data);

        struct sensor_q31_data bmp280_pres_data;
        bmp280_get_pres_data(&bmp280_pres_data);
        bmp280_printk_pres(&bmp280_pres_data);


        struct sensor_q31_data si7021_temp_data;
        si7021_get_temp_data(&si7021_temp_data);
        si7021_printk_temp(&si7021_temp_data);

        struct sensor_q31_data si7021_hume_data;
        si7021_get_hume_data(&si7021_hume_data);
        si7021_printk_hume(&si7021_hume_data);

        printk("-----------------------------\n");

        k_sleep(K_MSEC(1000));
	}
	return 0;
}
```
