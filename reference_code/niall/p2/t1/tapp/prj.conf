## CMakeLists.txt
```
set(ENV{EXTRA_ZEPHYR_MODULES}
    "/home/niall/csse4011/repo/mycode/p2/t1/mylib_clock"
)

cmake_minimum_required(VERSION 3.20.0)
find_package(Zephyr REQUIRED HINTS $ENV{ZEPHYR_BASE})
project(mylib_clock-tapp)

FILE(GLOB tapp_sources src/*.c)
target_sources(app PRIVATE ${tapp_sources})
```

## prj.conf
```kconfig
# CONFIG_SHELL=y

# CONFIG_LOG=y

# CONFIG_RTC=y
# CONFIG_COUNTER=y

# # Line 15 of zephyr/drivers/counter/CMakeLists.txt
# CONFIG_COUNTER_GECKO_RTCC=y


# Now we just need to set our library configuration.
CONFIG_MYLIB_CLOCK=y
# It will configure the rest of the ones above for us.
```

## src/main.c
```c
#include <mylib_clock_rtcc.h>

int log_loop(struct rtc_time *timeptr)
{
    while (1) {
        
        rtcc_get_rtc_time(&*timeptr);

        rtcc_log_rtc_time(&*timeptr);
        
        k_sleep(K_MSEC(1000));
    }
}

int main(void)
{
    rtcc_setup();

    struct rtc_time timeptr = {
        0, 
        0,
        0,
        4,
        4 - 1,
        2025 - BASE_YEAR,
        5,
        -1,
        -1,
        0
    };

    rtcc_set_rtc_time(&timeptr);

    log_loop(&timeptr);

    return 0;
}
```
