## CMakeLists.txt
```
# SPDX-License-Identifier: Apache-2.0

cmake_minimum_required(VERSION 3.20.0)

find_package(Zephyr REQUIRED HINTS $ENV{ZEPHYR_BASE})
project(board_viewer)

target_sources(app PRIVATE src/main.c)
```

## prj.conf
```kconfig
CONFIG_NETWORKING=y
CONFIG_NET_SOCKETS=y
CONFIG_NET_SOCKETS_POSIX_NAMES=y
CONFIG_NET_TCP=y
CONFIG_NET_IPV4=y
CONFIG_DNS_RESOLVER=y
CONFIG_MBEDTLS=y
CONFIG_MBEDTLS_BUILTIN=y
CONFIG_JSON_LIBRARY=y
```

## src/main.c
```c
#include <zephyr/net/http/client.h>

static void http_response_cb(struct http_response *rsp, 
                           enum http_final_call final_data, 
                           void *user_data)
{
    if (final_data == HTTP_DATA_MORE) {
        printk("Partial data received (%zd bytes)\n", rsp->data_len);
    } else if (final_data == HTTP_DATA_FINAL) {
        printk("All data received (%zd bytes)\n", rsp->data_len);
    }
    
    printk("Response status %d\n", rsp->http_status);
    printk("Body: %.*s\n", rsp->data_len, rsp->recv_buf);
}

static int send_http_request(struct tago_data *data)
{
    struct http_request req = {0};
    char payload[512];
    
    // Create JSON payload (same as before)
    
    req.method = HTTP_POST;
    req.url = "/data";
    req.host = TAGO_URL;
    req.protocol = "HTTPS";
    req.response = http_response_cb;
    req.payload = payload;
    req.payload_len = strlen(payload);
    req.header_fields = "Device-Token: " TAGO_DEVICE_TOKEN "\r\n"
                       "Content-Type: application/json\r\n";
    
    return http_client_req(NULL, &req, 5000, NULL);
}
```
