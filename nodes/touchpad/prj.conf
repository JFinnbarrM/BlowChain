## CMakeLists.txt
```
# SPDX-License-Identifier: Apache-2.0

cmake_minimum_required(VERSION 3.20.0)

find_package(Zephyr REQUIRED HINTS $ENV{ZEPHYR_BASE})
project(m5stack_keypad)

target_sources(app PRIVATE src/main.c)
```

## prj.conf
```kconfig
# M5Stack Core 2 Keypad with Bluetooth

# Display support
CONFIG_DISPLAY=y

# Input for touch
CONFIG_INPUT=y

# Hardware
CONFIG_GPIO=y
CONFIG_SPI=y
CONFIG_I2C=y

# Bluetooth support
CONFIG_BT=y
CONFIG_BT_PERIPHERAL=y
CONFIG_BT_DEVICE_NAME="M5Stack_Keypad"
CONFIG_BT_DEVICE_APPEARANCE=0
CONFIG_BT_MAX_CONN=1
CONFIG_BT_MAX_PAIRED=1

# Bluetooth LE Advertising
CONFIG_BT_BROADCASTER=y
CONFIG_BT_EXT_ADV=n

# Logging
CONFIG_LOG=y
CONFIG_LOG_DEFAULT_LEVEL=2
CONFIG_PRINTK=y
CONFIG_CONSOLE=y
CONFIG_UART_CONSOLE=y

# Memory configuration (increased for Bluetooth)
CONFIG_MAIN_STACK_SIZE=4096
CONFIG_SYSTEM_WORKQUEUE_STACK_SIZE=2048
CONFIG_HEAP_MEM_POOL_SIZE=16384

# Disable unused features
CONFIG_WIFI=n
CONFIG_NETWORKING=n
CONFIG_SHELL=n
CONFIG_LVGL=n

# PSRAM
CONFIG_ESP_SPIRAM=y
```

## m5stack_core2.overlay
```dts
/ {
    kbdmatrix: kbdmatrix {
        compatible = "gpio-kbd-matrix";
        status = "okay";
        row-gpios = <&gpio0 19 (GPIO_PULL_UP | GPIO_ACTIVE_LOW)>,  
                    <&gpio0 14 (GPIO_PULL_UP | GPIO_ACTIVE_LOW)>,
                    <&gpio0 26 (GPIO_PULL_UP | GPIO_ACTIVE_LOW)>;
        col-gpios = <&gpio0 33 GPIO_ACTIVE_LOW>,
                    <&gpio0 27 GPIO_ACTIVE_LOW>,
                    <&gpio0 32 GPIO_ACTIVE_LOW>;
        settle-time-us = <0>;
        no-ghostkey-check;

        keymap {
            compatible = "input-keymap";
            status = "okay";
            keymap = <
                MATRIX_KEY(0, 0, INPUT_KEY_1)
                MATRIX_KEY(0, 1, INPUT_KEY_2)
                MATRIX_KEY(0, 2, INPUT_KEY_3)
                MATRIX_KEY(1, 0, INPUT_KEY_4)
                MATRIX_KEY(1, 1, INPUT_KEY_5)
                MATRIX_KEY(1, 2, INPUT_KEY_6)
                MATRIX_KEY(2, 0, INPUT_KEY_7)
                MATRIX_KEY(2, 1, INPUT_KEY_8)
                MATRIX_KEY(2, 2, INPUT_KEY_9)
            >;
            row-size = <3>;
            col-size = <3>;
        };
    };
};
```

## src/main.c
```c
#include <zephyr/kernel.h>
#include <zephyr/device.h>
#include <zephyr/drivers/display.h>
#include <zephyr/input/input.h>
#include <zephyr/logging/log.h>
#include <zephyr/bluetooth/bluetooth.h>
#include <zephyr/bluetooth/hci.h>
#include <zephyr/sys/printk.h>

#define ADV_UPDATE_INTERVAL_MS 1000
#define PASSCODE_LENGTH 6

LOG_MODULE_REGISTER(main, LOG_LEVEL_INF);

#define DISPLAY_NODE DT_CHOSEN(zephyr_display)
#define TOUCH_NODE DT_CHOSEN(zephyr_touch)

#define SCREEN_WIDTH  320
#define SCREEN_HEIGHT 240
#define BUTTON_WIDTH  140  // Button width
#define BUTTON_HEIGHT 50   // Button height
#define BUTTON_GAP    10   // Space between buttons

/* Colors (RGB565) */
#define COLOR_BLACK     0x0000
#define COLOR_WHITE     0xFFFF
#define COLOR_GRAY      0x7BEF
#define COLOR_DARK_GRAY 0x39C7
#define COLOR_GREEN     0x07E0
#define COLOR_RED       0xF800
#define COLOR_BLUE      0x001F
#define COLOR_TAN 0xF4A500
#define COLOR_LILAC_PURPLE 0xD8A6F0



/* Button positions */
typedef struct {
    int x, y, w, h;
    int number;
} button_t;

/* Global variables */
static const struct device *display;
static button_t buttons[5]; /* 4 numbers + 1 enter button */
static char passcode[PASSCODE_LENGTH + 1] = {0};
static int passcode_pos = 0;
static int bluetooth_ready = 0;

static char* keypad_mac_str = "DA:AA:BB:BC:CC:FF";

/* Draw a filled rectangle */
static void draw_rect(int x, int y, int w, int h, uint16_t color)
{
    static uint16_t line_buf[SCREEN_WIDTH];
    
    /* Fill line buffer with color */
    for (int i = 0; i < w && i < SCREEN_WIDTH; i++) {
        line_buf[i] = color;
    }
    
    struct display_buffer_descriptor desc = {
        .buf_size = w * 2,
        .width = w,
        .height = 1,
        .pitch = w,
    };
    
    /* Draw rectangle line by line */
    for (int row = 0; row < h; row++) {
        display_write(display, x, y + row, &desc, line_buf);
    }
}

/* Simple 5x7 font bitmap for digits */
static const uint8_t font_5x7[][7] = {
    {0x1F, 0x11, 0x11, 0x11, 0x1F}, /* 0 */
    {0x04, 0x0C, 0x04, 0x04, 0x0E}, /* 1 */
    {0x1F, 0x01, 0x1F, 0x10, 0x1F}, /* 2 */
    {0x1F, 0x01, 0x0F, 0x01, 0x1F}, /* 3 */
    {0x11, 0x11, 0x1F, 0x01, 0x01}, /* 4 */
    {0x1F, 0x10, 0x1F, 0x01, 0x1F}, /* 5 */
    {0x1F, 0x10, 0x1F, 0x11, 0x1F}, /* 6 */
    {0x1F, 0x01, 0x01, 0x01, 0x01}, /* 7 */
    {0x1F, 0x11, 0x1F, 0x11, 0x1F}, /* 8 */
    {0x1F, 0x11, 0x1F, 0x01, 0x1F}, /* 9 */
};

/* Draw a character */
static void draw_char(int x, int y, char c, uint16_t color)
{
    if (c < '0' || c > '9') return;
    
    int digit = c - '0';
    
    for (int row = 0; row < 7; row++) {
        uint8_t line = font_5x7[digit][row];
        for (int col = 0; col < 5; col++) {
            if (line & (1 << (4 - col))) {
                /* Draw pixel */
                uint16_t pixel = color;
                struct display_buffer_descriptor desc = {
                    .buf_size = 2,
                    .width = 1,
                    .height = 1,
                    .pitch = 1,
                };
                display_write(display, x + col, y + row, &desc, &pixel);
            }
        }
    }
}

/* Draw text string */
static void draw_text(int x, int y, const char *text, uint16_t color)
{
    int pos_x = x;
    while (*text) {
        if (*text == '*') {
            /* Draw asterisk for hidden passcode */
            draw_rect(pos_x + 2, y + 3, 2, 2, color);
        } else {
            draw_char(pos_x, y, *text, color);
        }
        pos_x += 6; /* 5 pixel width + 1 spacing */
        text++;
    }
}


// /* Button positions */
// static void init_buttons(void)
// {
//     /* 2x2 grid for numbers 1-4 */
//     for (int i = 0; i < 4; i++) {
//         int row = i / 2;  // Determine row (0 or 1)
//         int col = i % 2;  // Determine column (0 or 1)
        
//         // Shift numbers more to the left
//         buttons[i].x = 20 + col * (BUTTON_WIDTH + BUTTON_GAP);  
//         buttons[i].y = 80 + row * (BUTTON_HEIGHT + BUTTON_GAP); 
//         buttons[i].w = BUTTON_WIDTH;
//         buttons[i].h = BUTTON_HEIGHT;
//         buttons[i].number = i + 1;
//     }
    
//     /* Enter button */
//     buttons[4].x = 90;
//     buttons[4].y = 200;  // Back to original position
//     buttons[4].w = BUTTON_WIDTH;
//     buttons[4].h = BUTTON_HEIGHT;
//     buttons[4].number = -1;  // No number associated with the Enter button
// }






/* Button positions */
static void init_buttons(void)
{
    /* 2x2 grid for numbers 1-4 */
    for (int i = 0; i < 4; i++) {
        int row = i / 2;  // Determine row (0 or 1)
        int col = i % 2;  // Determine column (0 or 1)
        
        // Shift numbers more to the left
        buttons[i].x = 20 + col * (BUTTON_WIDTH + BUTTON_GAP);  
        buttons[i].y = 80 + row * (BUTTON_HEIGHT + BUTTON_GAP); 
        buttons[i].w = BUTTON_WIDTH;
        buttons[i].h = BUTTON_HEIGHT;
        buttons[i].number = i + 1;
    }

    buttons[4].x = 90;
    buttons[4].y = 200; 
    buttons[4].w = BUTTON_WIDTH;
    buttons[4].h = BUTTON_HEIGHT;
    buttons[4].number = -1;  // Use -1 for the CLEAR button (instead of 0 or any number)
}










// /* Draw a button */
// static void draw_button(button_t *btn, bool pressed)
// {
//     uint16_t bg_color = pressed ? COLOR_GRAY : COLOR_DARK_GRAY;
//     uint16_t border_color = COLOR_WHITE;
    
//     /* Draw button background */
//     draw_rect(btn->x, btn->y, btn->w, btn->h, bg_color);
    
//     /* Draw border */
//     draw_rect(btn->x, btn->y, btn->w, 1, border_color); /* top */
//     draw_rect(btn->x, btn->y + btn->h - 1, btn->w, 1, border_color); /* bottom */
//     draw_rect(btn->x, btn->y, 1, btn->h, border_color); /* left */
//     draw_rect(btn->x + btn->w - 1, btn->y, 1, btn->h, border_color); /* right */
    
//     /* Draw button text */
//     if (btn->number >= 1 && btn->number <= 4) {
//         char text[2] = {'0' + btn->number, '\0'};
//         draw_text(btn->x + btn->w / 2 - 3, btn->y + btn->h / 2 - 3, text, COLOR_WHITE);
//     } else if (btn->number == 0) {
//         draw_text(btn->x + 8, btn->y + btn->h / 2 - 3, "ENTER", COLOR_WHITE);
//     }
// }

static void draw_button(button_t *btn, bool pressed)
{
    uint16_t bg_color = COLOR_DARK_GRAY;  // Default color for non-clear buttons
    
    // Check if the button is the "CLEAR" button (formerly Enter button)
    if (btn->number == -1) {
        bg_color = pressed ? COLOR_LILAC_PURPLE : COLOR_LILAC_PURPLE;  // Set to lilac purple
    }
    // Check if the button is one of the number buttons (1-4)
    else if (btn->number >= 1 && btn->number <= 4) {
        bg_color = pressed ? COLOR_TAN : COLOR_TAN;  // Set to tan
    }
    
    uint16_t border_color = COLOR_WHITE;
    
    /* Draw button background */
    draw_rect(btn->x, btn->y, btn->w, btn->h, bg_color);
    
    /* Draw border */
    draw_rect(btn->x, btn->y, btn->w, 1, border_color); /* top */
    draw_rect(btn->x, btn->y + btn->h - 1, btn->w, 1, border_color); /* bottom */
    draw_rect(btn->x, btn->y, 1, btn->h, border_color); /* left */
    draw_rect(btn->x + btn->w - 1, btn->y, 1, btn->h, border_color); /* right */
    
    /* Draw button text */
    if (btn->number >= 1 && btn->number <= 4) {
        char text[2] = {'0' + btn->number, '\0'};
        draw_text(btn->x + btn->w / 2 - 3, btn->y + btn->h / 2 - 3, text, COLOR_WHITE);
    } else if (btn->number == -1) {
        draw_text(btn->x + 8, btn->y + btn->h / 2 - 3, "CLEAR", COLOR_WHITE); // "CLEAR" for the button
    }
}





/* Update display with current passcode */
static void update_display(void)
{
    /* Clear display area */
    draw_rect(50, 30, 220, 20, COLOR_BLACK);
    
    /* Show passcode as asterisks if complete, otherwise show digits */
    if (passcode_pos == PASSCODE_LENGTH) {
        draw_text(110, 35, "COMPLETE", COLOR_GREEN);
    } else if (passcode_pos > 0) {
        /* Show asterisks for entered digits */
        char display_text[PASSCODE_LENGTH + 1];
        for (int i = 0; i < passcode_pos; i++) {
            display_text[i] = '*';
        }
        display_text[passcode_pos] = '\0';
        draw_text(55 + (PASSCODE_LENGTH - passcode_pos) * 6, 35, display_text, COLOR_GREEN);
    }
    
    /* Show passcode counter */
    char counter[16];
    snprintf(counter, sizeof(counter), "%d/%d", passcode_pos, PASSCODE_LENGTH);
    draw_text(280, 35, counter, COLOR_BLUE);
}

/* Check if point is inside button */
static int point_in_button(int x, int y)
{
    // Swap x and y for flipped coordinate system
    int temp = x;
    x = y;
    y = temp;

    for (int i = 0; i < 5; i++) {  // 4 number buttons + 1 enter button
        if (x >= buttons[i].x && x < buttons[i].x + buttons[i].w &&
            y >= buttons[i].y && y < buttons[i].y + buttons[i].h) {
            return i;
        }
    }
    return -1;
}



/* Handle button press */
// static void handle_button_press(int btn_idx)
// {
//     if (btn_idx < 0 || btn_idx >= 5) return;
    
//     button_t *btn = &buttons[btn_idx];
    
//     /* Visual feedback */
//     draw_button(btn, true);
//     k_msleep(100);
//     draw_button(btn, false);
    
//     if (btn->number >= 1 && btn->number <= 4) {
//         /* Number button */
//         if (passcode_pos < PASSCODE_LENGTH) {
//             passcode[passcode_pos++] = '0' + btn->number;
//             passcode[passcode_pos] = '\0';
//             LOG_INF("Button %d pressed, passcode position: %d", btn->number, passcode_pos);
            
//             if (passcode_pos == PASSCODE_LENGTH) {
//                 LOG_INF("Passcode complete: %s", passcode);
//             }
//         }
//     } else if (btn->number == 0) {
//         /* Enter button */
//         if (passcode_pos == PASSCODE_LENGTH) {
//             LOG_INF("Passcode entered: %s", passcode);
//         }
//     }
    
//     /* Update display */
//     update_display();
// }







/* Handle button press */
static void handle_button_press(int btn_idx)
{
    if (btn_idx < 0 || btn_idx >= 5) return;
    
    button_t *btn = &buttons[btn_idx];
    
    /* Visual feedback */
    draw_button(btn, true);
    k_msleep(100);
    draw_button(btn, false);
    
    if (btn->number >= 1 && btn->number <= 4) {
        /* Number button */
        if (passcode_pos < PASSCODE_LENGTH) {
            passcode[passcode_pos++] = '0' + btn->number;
            passcode[passcode_pos] = '\0';
            LOG_INF("Button %d pressed, passcode position: %d", btn->number, passcode_pos);
            
            if (passcode_pos == PASSCODE_LENGTH) {
                LOG_INF("Passcode complete: %s", passcode);
            }
        }
    } else if (btn->number == -1) {
        /* CLEAR button (was originally Enter) */
        passcode_pos = 0;  // Clear the passcode
        passcode[0] = '\0';  // Reset the passcode string
        LOG_INF("Passcode cleared.");
    }
    
    /* Update display */
    update_display();
}

/* Touch input callback */
static void input_callback(struct input_event *evt, void *user_data)
{
    static int touch_x = -1, touch_y = -1;
    static bool touch_pressed = false;
    
    if (evt->type == INPUT_EV_ABS) {
        if (evt->code == INPUT_ABS_X) {
            touch_x = evt->value;
        } else if (evt->code == INPUT_ABS_Y) {
            touch_y = evt->value;
        }
    } else if (evt->type == INPUT_EV_KEY) {
        if (evt->code == INPUT_BTN_TOUCH) {
            if (evt->value == 1 && !touch_pressed) {
                /* Touch press */
                touch_pressed = true;
                if (touch_x >= 0 && touch_y >= 0) {
                    int btn_idx = point_in_button(touch_x, touch_y);
                    if (btn_idx >= 0) {
                        handle_button_press(btn_idx);
                    }
                }
            } else if (evt->value == 0) {
                /* Touch release */
                touch_pressed = false;
            }
        }
    }
}

INPUT_CALLBACK_DEFINE(DEVICE_DT_GET(TOUCH_NODE), input_callback, NULL);

/* Bluetooth functions */
static void start_advertising_keypad(void)
{
    printk("Starting Bluetooth advertising...\n");

    struct bt_le_adv_param param = {
        .options = BT_LE_ADV_OPT_USE_IDENTITY,
        .interval_min = BT_GAP_ADV_FAST_INT_MIN_2,
        .interval_max = BT_GAP_ADV_FAST_INT_MAX_2,
        .id = 0,
    };

    struct bt_data ad[] = {
        BT_DATA_BYTES(BT_DATA_FLAGS, BT_LE_AD_NO_BREDR),
        BT_DATA_BYTES(BT_DATA_MANUFACTURER_DATA, 0x4C, 0x00, 0x01, 0x02, 0x03, 0x04, 0x05, 0x06),
    };

    int err = bt_le_adv_start(&param, ad, ARRAY_SIZE(ad), NULL, 0);
    if (err) {
        printk("Failed to start advertising (err %d)\n", err);
        return;
    }

    printk("Bluetooth advertising started successfully\n");

    while (1) {
        /* Create passcode payload */
        uint8_t passcode_payload[8] = {
            0x4C, 0x00, /* Company ID */
            passcode_pos >= 1 ? passcode[0] : '0',
            passcode_pos >= 2 ? passcode[1] : '0',
            passcode_pos >= 3 ? passcode[2] : '0',
            passcode_pos >= 4 ? passcode[3] : '0',
            passcode_pos >= 5 ? passcode[4] : '0',
            passcode_pos >= 6 ? passcode[5] : '0',
        };

        struct bt_data updated_ad[] = {
            BT_DATA_BYTES(BT_DATA_FLAGS, BT_LE_AD_NO_BREDR),
            BT_DATA(BT_DATA_MANUFACTURER_DATA, passcode_payload, sizeof(passcode_payload)),
        };

        err = bt_le_adv_update_data(updated_ad, ARRAY_SIZE(updated_ad), NULL, 0);
        if (err == 0) {
            printk("Advertising updated with passcode: %s (%d digits)\n", 
                   passcode_pos > 0 ? passcode : "empty", passcode_pos);

                   
        }
        k_msleep(ADV_UPDATE_INTERVAL_MS);
    }
}

void bluetooth_thread_keypad(void)
{
    while (!bluetooth_ready) {
        k_msleep(100);
    }
    start_advertising_keypad();
}

void bluetooth_ready_cb(int err)
{
    if (err) {
        printk("Bluetooth init failed (err %d)\n", err);
        return;
    }
    printk("Bluetooth initialized\n");
    bluetooth_ready = 1;
}

void bluetooth_init_keypad(void)
{
    int err = bt_enable(bluetooth_ready_cb);
    if (err) {
        printk("bt_enable failed (err %d)\n", err);
    }
}

// Add this in the main() function, right after LOG_INF("M5Stack Keypad with Bluetooth Starting");
static void set_keypad_mac(void) {
    bt_addr_le_t keypad_addr;
    bt_addr_le_from_str(keypad_mac_str, "random", &keypad_addr);
    
    int err = bt_id_create(&keypad_addr, NULL);
    if (err < 0) {
        LOG_ERR("Failed to set keypad MAC address: %d", err);
    } else {
        LOG_INF("Keypad MAC address set to: %s", keypad_mac_str);
    }
}

/* Define Bluetooth thread */
K_THREAD_DEFINE(bt_thread, 2048, bluetooth_thread_keypad, NULL, NULL, NULL, 
                K_PRIO_COOP(7), 0, 0);

int main(void)
{
    LOG_INF("M5Stack Keypad with Bluetooth Starting");
    
    
    /* Initialize display */
    display = DEVICE_DT_GET(DISPLAY_NODE);
    if (!device_is_ready(display)) {
        LOG_ERR("Display not ready");
        return -1;
    }
    
    display_blanking_off(display);
    LOG_INF("Display ready");
    
    set_keypad_mac();

    /* Initialize Bluetooth */
    bluetooth_init_keypad();
    LOG_INF("Bluetooth initialization started");

    
    /* Clear screen */
    draw_rect(0, 0, SCREEN_WIDTH, SCREEN_HEIGHT, COLOR_BLACK);
    
    /* Draw title */
    draw_text(90, 10, "M5STACK PASSCODE", COLOR_WHITE);
    
    /* Draw display area border */
    draw_rect(48, 28, 224, 24, COLOR_DARK_GRAY);
    draw_rect(50, 30, 220, 20, COLOR_BLACK);
    
    /* Initialize and draw buttons */
    init_buttons();
    for (int i = 0; i < 10; i++) {
        draw_button(&buttons[i], false);
    }
    
    /* Initial display update */
    update_display();
    
    LOG_INF("Ready - Touch buttons to enter 6-digit passcode");
    
    return 0;
}
```
