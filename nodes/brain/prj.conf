## prj.conf
```kconfig
# Enable PWM and GPIO
CONFIG_PWM=y
CONFIG_GPIO=y

# Allows bluetooth.
CONFIG_BT=y
# Allows bluetooth operation as an observer.
CONFIG_BT_OBSERVER=y
# Allows bluetooth operation as a broadcaster.
CONFIG_BT_BROADCASTER=y
CONFIG_BT_PERIPHERAL=y
CONFIG_BT_DEVICE_NAME="SecureLockbox"

# Activates and allows usage of the shell.
CONFIG_SHELL=y
# # So that multiple shell commands can be copied in at once.
CONFIG_SHELL_BACKEND_SERIAL_RX_RING_BUFFER_SIZE=8192

# Allows memory allocation (malloc).
CONFIG_HEAP_MEM_POOL_SIZE=1024

# Allows logging.
CONFIG_LOG=y

# Minimal BlowChain Configuration for DISCO-L475VG-IOT01A

# Basic System
CONFIG_MAIN_STACK_SIZE=2048
CONFIG_HEAP_MEM_POOL_SIZE=8192

# File System (for blockchain storage)
CONFIG_FILE_SYSTEM=y
CONFIG_FILE_SYSTEM_LITTLEFS=y

# Flash Storage
CONFIG_FLASH=y
CONFIG_FLASH_MAP=y

# Logging
CONFIG_LOG=y
CONFIG_SERIAL=y
CONFIG_CONSOLE=y
CONFIG_UART_CONSOLE=y

# Threading
CONFIG_MULTITHREADING=y

CONFIG_PRINTK=y
CONFIG_HEAP_MEM_POOL_SIZE=1024
CONFIG_GPIO=y

CONFIG_TICKLESS_KERNEL=y
CONFIG_LOG=y
CONFIG_LOG_DEFAULT_LEVEL=0
CONFIG_LOG_CMDS=y
CONFIG_LOG_RUNTIME_FILTERING=n


CONFIG_STDOUT_CONSOLE=y
CONFIG_I2C=y
CONFIG_SENSOR=y


CONFIG_RTT_CONSOLE=y
CONFIG_USE_SEGGER_RTT=y
CONFIG_CBPRINTF_FP_SUPPORT=y

CONFIG_BT=y
CONFIG_BT_BROADCASTER=y
```

## boards/nrf52840dk_nrf52840.overlay
```dts
&pwm0 {
    status = "okay";
};
```

## include/lock.h
```c
#include <stdbool.h>

typedef enum {
    LOCK_CLOSED = 0,
    LOCK_OPEN = 1
} lock_state_t;

void lock_init(void);
void lock_open(void);
void lock_close(void);
bool lock_is_open(void);
bool lock_is_closed(void);
```

## src/lock.c
```c
#include "lock.h"

#include <zephyr/device.h>
#include <zephyr/drivers/pwm.h>
#include <zephyr/logging/log.h>
#include <zephyr/sys/atomic.h>

LOG_MODULE_REGISTER(lock);

// Updated pulse widths for standard servos
#define LOCK_OPEN_PULSE PWM_MSEC(2.0)   // 1.0ms pulse (0°)
#define LOCK_CLOSE_PULSE PWM_MSEC(1.0)  // 2.0ms pulse (90°)
#define SERVO_PERIOD PWM_MSEC(20)      // 20ms period (50Hz)

static const struct device *lock_device = DEVICE_DT_GET(DT_NODELABEL(pwm0));
static atomic_t lock_state = ATOMIC_INIT(LOCK_CLOSED);

static void set_lock_position(lock_state_t state)
{
    if (state == LOCK_OPEN) {
        pwm_set(lock_device, 0, SERVO_PERIOD, LOCK_OPEN_PULSE, PWM_POLARITY_NORMAL);
        atomic_set(&lock_state, LOCK_OPEN);
        LOG_INF("Servo moved to OPEN position (1.0ms pulse)");
    } else {
        pwm_set(lock_device, 0, SERVO_PERIOD, LOCK_CLOSE_PULSE, PWM_POLARITY_NORMAL);
        atomic_set(&lock_state, LOCK_CLOSED);
        LOG_INF("Servo moved to CLOSED position (2.0ms pulse)");
    }
}

void lock_init(void)
{
    if (!device_is_ready(lock_device)) {
        LOG_ERR("PWM device not ready");
        return;
    }
    
    // Initialize to closed position
    set_lock_position(LOCK_CLOSED);
    LOG_INF("Servo initialized to CLOSED position");
}

void lock_open(void)
{
    set_lock_position(LOCK_OPEN);
}

void lock_close(void)
{
    set_lock_position(LOCK_CLOSED);
}

bool lock_is_open(void)
{
    return atomic_get(&lock_state) == LOCK_OPEN;
}

bool lock_is_closed(void)
{
    return atomic_get(&lock_state) == LOCK_CLOSED;
}
```
