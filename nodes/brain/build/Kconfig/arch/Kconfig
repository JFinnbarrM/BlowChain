## nodes/brain/build/Kconfig/arch/Kconfig
```kconfig
# Load Zephyr Arch Kconfig descriptions.
osource "/home/james/repo/zephyr/arch/x86/Kconfig"
osource "/home/james/repo/zephyr/arch/xtensa/Kconfig"
osource "/home/james/repo/zephyr/arch/sparc/Kconfig"
osource "/home/james/repo/zephyr/arch/riscv/Kconfig"
osource "/home/james/repo/zephyr/arch/posix/Kconfig"
osource "/home/james/repo/zephyr/arch/nios2/Kconfig"
osource "/home/james/repo/zephyr/arch/mips/Kconfig"
osource "/home/james/repo/zephyr/arch/arm64/Kconfig"
osource "/home/james/repo/zephyr/arch/arm/Kconfig"
osource "/home/james/repo/zephyr/arch/arc/Kconfig"
```

## nodes/brain/build/Kconfig/boards/Kconfig.nrf52840dk
```kconfig
# Load board Kconfig descriptions.
osource "/home/james/repo/zephyr/boards/nordic/nrf52840dk/Kconfig.nrf52840dk"
```

## nodes/brain/build/Kconfig/boards/Kconfig.sysbuild
```kconfig
# Load Sysbuild board Kconfig descriptions.
osource "/home/james/repo/zephyr/boards/nordic/nrf52840dk/Kconfig.sysbuild"
```

## nodes/brain/build/Kconfig/soc/Kconfig
```kconfig
# Load Zephyr SoC Kconfig descriptions.
osource "/home/james/repo/zephyr/soc/xlnx/zynqmp/Kconfig"
osource "/home/james/repo/zephyr/soc/xlnx/zynq7000/Kconfig"
osource "/home/james/repo/zephyr/soc/xen/Kconfig"
osource "/home/james/repo/zephyr/soc/wch/ch32v/Kconfig"
osource "/home/james/repo/zephyr/soc/ti/simplelink/Kconfig"
osource "/home/james/repo/zephyr/soc/ti/lm3s6965/Kconfig"
osource "/home/james/repo/zephyr/soc/ti/k3/Kconfig"
osource "/home/james/repo/zephyr/soc/telink/tlsr/Kconfig"
osource "/home/james/repo/zephyr/soc/starfive/jh71xx/Kconfig"
osource "/home/james/repo/zephyr/soc/st/stm32/Kconfig"
osource "/home/james/repo/zephyr/soc/snps/qemu_arc/Kconfig"
osource "/home/james/repo/zephyr/soc/snps/nsim/arc_v/Kconfig"
osource "/home/james/repo/zephyr/soc/snps/nsim/arc_classic/Kconfig"
osource "/home/james/repo/zephyr/soc/snps/hsdk4xd/Kconfig"
osource "/home/james/repo/zephyr/soc/snps/hsdk/Kconfig"
osource "/home/james/repo/zephyr/soc/snps/emsk/Kconfig"
osource "/home/james/repo/zephyr/soc/snps/emsdp/Kconfig"
osource "/home/james/repo/zephyr/soc/snps/arc_iot/Kconfig"
osource "/home/james/repo/zephyr/soc/silabs/Kconfig"
osource "/home/james/repo/zephyr/soc/sifive/sifive_freedom/Kconfig"
osource "/home/james/repo/zephyr/soc/sensry/Kconfig"
osource "/home/james/repo/zephyr/soc/rockchip/Kconfig"
osource "/home/james/repo/zephyr/soc/renode/riscv_virtual/Kconfig"
osource "/home/james/repo/zephyr/soc/renode/cortex_r8_virtual/Kconfig"
osource "/home/james/repo/zephyr/soc/renesas/smartbond/Kconfig"
osource "/home/james/repo/zephyr/soc/renesas/rzt2m/Kconfig"
osource "/home/james/repo/zephyr/soc/renesas/rz/Kconfig"
osource "/home/james/repo/zephyr/soc/renesas/rcar/Kconfig"
osource "/home/james/repo/zephyr/soc/renesas/ra/Kconfig"
osource "/home/james/repo/zephyr/soc/realtek/ec/Kconfig"
osource "/home/james/repo/zephyr/soc/raspberrypi/rpi_pico/Kconfig"
osource "/home/james/repo/zephyr/soc/quicklogic/eos_s3/Kconfig"
osource "/home/james/repo/zephyr/soc/qemu/virt_riscv/Kconfig"
osource "/home/james/repo/zephyr/soc/qemu/malta/Kconfig"
osource "/home/james/repo/zephyr/soc/openisa/rv32m1/Kconfig"
osource "/home/james/repo/zephyr/soc/oct/osd32mp15x/Kconfig"
osource "/home/james/repo/zephyr/soc/nxp/s32/Kconfig"
osource "/home/james/repo/zephyr/soc/nxp/rw/Kconfig"
osource "/home/james/repo/zephyr/soc/nxp/mcx/Kconfig"
osource "/home/james/repo/zephyr/soc/nxp/lpc/Kconfig"
osource "/home/james/repo/zephyr/soc/nxp/layerscape/Kconfig"
osource "/home/james/repo/zephyr/soc/nxp/kinetis/Kconfig"
osource "/home/james/repo/zephyr/soc/nxp/imxrt/Kconfig"
osource "/home/james/repo/zephyr/soc/nxp/imx/Kconfig"
osource "/home/james/repo/zephyr/soc/nuvoton/numicro/Kconfig"
osource "/home/james/repo/zephyr/soc/nuvoton/numaker/Kconfig"
osource "/home/james/repo/zephyr/soc/nuvoton/npcx/Kconfig"
osource "/home/james/repo/zephyr/soc/nuvoton/npcm/Kconfig"
osource "/home/james/repo/zephyr/soc/nordic/Kconfig"
osource "/home/james/repo/zephyr/soc/neorv32/Kconfig"
osource "/home/james/repo/zephyr/soc/native/inf_clock/Kconfig"
osource "/home/james/repo/zephyr/soc/microchip/miv/Kconfig"
osource "/home/james/repo/zephyr/soc/microchip/mec/Kconfig"
osource "/home/james/repo/zephyr/soc/mediatek/mt8xxx/Kconfig"
osource "/home/james/repo/zephyr/soc/lowrisc/opentitan/Kconfig"
osource "/home/james/repo/zephyr/soc/litex/litex_vexriscv/Kconfig"
osource "/home/james/repo/zephyr/soc/ite/ec/Kconfig"
osource "/home/james/repo/zephyr/soc/intel/raptor_lake/Kconfig"
osource "/home/james/repo/zephyr/soc/intel/lakemont/Kconfig"
osource "/home/james/repo/zephyr/soc/intel/intel_socfpga_std/Kconfig"
osource "/home/james/repo/zephyr/soc/intel/intel_socfpga/Kconfig"
osource "/home/james/repo/zephyr/soc/intel/intel_niosv/Kconfig"
osource "/home/james/repo/zephyr/soc/intel/intel_ish/Kconfig"
osource "/home/james/repo/zephyr/soc/intel/intel_adsp/Kconfig"
osource "/home/james/repo/zephyr/soc/intel/elkhart_lake/Kconfig"
osource "/home/james/repo/zephyr/soc/intel/atom/Kconfig"
osource "/home/james/repo/zephyr/soc/intel/apollo_lake/Kconfig"
osource "/home/james/repo/zephyr/soc/intel/alder_lake/Kconfig"
osource "/home/james/repo/zephyr/soc/infineon/cat3/Kconfig"
osource "/home/james/repo/zephyr/soc/infineon/cat1b/Kconfig"
osource "/home/james/repo/zephyr/soc/infineon/cat1a/Kconfig"
osource "/home/james/repo/zephyr/soc/gd/gd32/Kconfig"
osource "/home/james/repo/zephyr/soc/gaisler/leon3/Kconfig"
osource "/home/james/repo/zephyr/soc/gaisler/gr716a/Kconfig"
osource "/home/james/repo/zephyr/soc/espressif/Kconfig"
osource "/home/james/repo/zephyr/soc/ene/kb1200/Kconfig"
osource "/home/james/repo/zephyr/soc/efinix/sapphire/Kconfig"
osource "/home/james/repo/zephyr/soc/cdns/xtensa_sample_controller/Kconfig"
osource "/home/james/repo/zephyr/soc/cdns/sample_controller32/Kconfig"
osource "/home/james/repo/zephyr/soc/cdns/dc233c/Kconfig"
osource "/home/james/repo/zephyr/soc/brcm/bcmvk/Kconfig"
osource "/home/james/repo/zephyr/soc/brcm/bcm2712/Kconfig"
osource "/home/james/repo/zephyr/soc/brcm/bcm2711/Kconfig"
osource "/home/james/repo/zephyr/soc/atmel/sam0/Kconfig"
osource "/home/james/repo/zephyr/soc/atmel/sam/Kconfig"
osource "/home/james/repo/zephyr/soc/aspeed/Kconfig"
osource "/home/james/repo/zephyr/soc/arm/Kconfig"
osource "/home/james/repo/zephyr/soc/arm/beetle/Kconfig"
osource "/home/james/repo/zephyr/soc/antmicro/myra/Kconfig"
osource "/home/james/repo/zephyr/soc/andestech/Kconfig"
osource "/home/james/repo/zephyr/soc/amd/acp_6_0/Kconfig"
osource "/home/james/repo/zephyr/soc/ambiq/Kconfig"
osource "/home/james/repo/zephyr/soc/altr/zephyr_nios2f/Kconfig"
osource "/home/james/repo/zephyr/soc/altr/qemu_nios2/Kconfig"
osource "/home/james/repo/zephyr/soc/adi/max32/Kconfig"
```

## nodes/brain/build/Kconfig/soc/Kconfig.defconfig
```kconfig
# Load Zephyr SoC defconfig descriptions.
osource "/home/james/repo/zephyr/soc/xlnx/zynqmp/Kconfig.defconfig"
osource "/home/james/repo/zephyr/soc/xlnx/zynq7000/Kconfig.defconfig"
osource "/home/james/repo/zephyr/soc/xen/Kconfig.defconfig"
osource "/home/james/repo/zephyr/soc/wch/ch32v/Kconfig.defconfig"
osource "/home/james/repo/zephyr/soc/ti/simplelink/Kconfig.defconfig"
osource "/home/james/repo/zephyr/soc/ti/lm3s6965/Kconfig.defconfig"
osource "/home/james/repo/zephyr/soc/ti/k3/Kconfig.defconfig"
osource "/home/james/repo/zephyr/soc/telink/tlsr/Kconfig.defconfig"
osource "/home/james/repo/zephyr/soc/starfive/jh71xx/Kconfig.defconfig"
osource "/home/james/repo/zephyr/soc/st/stm32/Kconfig.defconfig"
osource "/home/james/repo/zephyr/soc/snps/qemu_arc/Kconfig.defconfig"
osource "/home/james/repo/zephyr/soc/snps/nsim/arc_v/Kconfig.defconfig"
osource "/home/james/repo/zephyr/soc/snps/nsim/arc_classic/Kconfig.defconfig"
osource "/home/james/repo/zephyr/soc/snps/hsdk4xd/Kconfig.defconfig"
osource "/home/james/repo/zephyr/soc/snps/hsdk/Kconfig.defconfig"
osource "/home/james/repo/zephyr/soc/snps/emsk/Kconfig.defconfig"
osource "/home/james/repo/zephyr/soc/snps/emsdp/Kconfig.defconfig"
osource "/home/james/repo/zephyr/soc/snps/arc_iot/Kconfig.defconfig"
osource "/home/james/repo/zephyr/soc/silabs/Kconfig.defconfig"
osource "/home/james/repo/zephyr/soc/sifive/sifive_freedom/Kconfig.defconfig"
osource "/home/james/repo/zephyr/soc/sensry/Kconfig.defconfig"
osource "/home/james/repo/zephyr/soc/rockchip/Kconfig.defconfig"
osource "/home/james/repo/zephyr/soc/renode/riscv_virtual/Kconfig.defconfig"
osource "/home/james/repo/zephyr/soc/renode/cortex_r8_virtual/Kconfig.defconfig"
osource "/home/james/repo/zephyr/soc/renesas/smartbond/Kconfig.defconfig"
osource "/home/james/repo/zephyr/soc/renesas/rzt2m/Kconfig.defconfig"
osource "/home/james/repo/zephyr/soc/renesas/rz/Kconfig.defconfig"
osource "/home/james/repo/zephyr/soc/renesas/rcar/Kconfig.defconfig"
osource "/home/james/repo/zephyr/soc/renesas/ra/Kconfig.defconfig"
osource "/home/james/repo/zephyr/soc/realtek/ec/Kconfig.defconfig"
osource "/home/james/repo/zephyr/soc/raspberrypi/rpi_pico/Kconfig.defconfig"
osource "/home/james/repo/zephyr/soc/quicklogic/eos_s3/Kconfig.defconfig"
osource "/home/james/repo/zephyr/soc/qemu/virt_riscv/Kconfig.defconfig"
osource "/home/james/repo/zephyr/soc/qemu/malta/Kconfig.defconfig"
osource "/home/james/repo/zephyr/soc/openisa/rv32m1/Kconfig.defconfig"
osource "/home/james/repo/zephyr/soc/oct/osd32mp15x/Kconfig.defconfig"
osource "/home/james/repo/zephyr/soc/nxp/s32/Kconfig.defconfig"
osource "/home/james/repo/zephyr/soc/nxp/rw/Kconfig.defconfig"
osource "/home/james/repo/zephyr/soc/nxp/mcx/Kconfig.defconfig"
osource "/home/james/repo/zephyr/soc/nxp/lpc/Kconfig.defconfig"
osource "/home/james/repo/zephyr/soc/nxp/layerscape/Kconfig.defconfig"
osource "/home/james/repo/zephyr/soc/nxp/kinetis/Kconfig.defconfig"
osource "/home/james/repo/zephyr/soc/nxp/imxrt/Kconfig.defconfig"
osource "/home/james/repo/zephyr/soc/nxp/imx/Kconfig.defconfig"
osource "/home/james/repo/zephyr/soc/nuvoton/numicro/Kconfig.defconfig"
osource "/home/james/repo/zephyr/soc/nuvoton/numaker/Kconfig.defconfig"
osource "/home/james/repo/zephyr/soc/nuvoton/npcx/Kconfig.defconfig"
osource "/home/james/repo/zephyr/soc/nuvoton/npcm/Kconfig.defconfig"
osource "/home/james/repo/zephyr/soc/nordic/Kconfig.defconfig"
osource "/home/james/repo/zephyr/soc/neorv32/Kconfig.defconfig"
osource "/home/james/repo/zephyr/soc/native/inf_clock/Kconfig.defconfig"
osource "/home/james/repo/zephyr/soc/microchip/miv/Kconfig.defconfig"
osource "/home/james/repo/zephyr/soc/microchip/mec/Kconfig.defconfig"
osource "/home/james/repo/zephyr/soc/mediatek/mt8xxx/Kconfig.defconfig"
osource "/home/james/repo/zephyr/soc/lowrisc/opentitan/Kconfig.defconfig"
osource "/home/james/repo/zephyr/soc/litex/litex_vexriscv/Kconfig.defconfig"
osource "/home/james/repo/zephyr/soc/ite/ec/Kconfig.defconfig"
osource "/home/james/repo/zephyr/soc/intel/raptor_lake/Kconfig.defconfig"
osource "/home/james/repo/zephyr/soc/intel/lakemont/Kconfig.defconfig"
osource "/home/james/repo/zephyr/soc/intel/intel_socfpga_std/Kconfig.defconfig"
osource "/home/james/repo/zephyr/soc/intel/intel_socfpga/Kconfig.defconfig"
osource "/home/james/repo/zephyr/soc/intel/intel_niosv/Kconfig.defconfig"
osource "/home/james/repo/zephyr/soc/intel/intel_ish/Kconfig.defconfig"
osource "/home/james/repo/zephyr/soc/intel/intel_adsp/Kconfig.defconfig"
osource "/home/james/repo/zephyr/soc/intel/elkhart_lake/Kconfig.defconfig"
osource "/home/james/repo/zephyr/soc/intel/atom/Kconfig.defconfig"
osource "/home/james/repo/zephyr/soc/intel/apollo_lake/Kconfig.defconfig"
osource "/home/james/repo/zephyr/soc/intel/alder_lake/Kconfig.defconfig"
osource "/home/james/repo/zephyr/soc/infineon/cat3/Kconfig.defconfig"
osource "/home/james/repo/zephyr/soc/infineon/cat1b/Kconfig.defconfig"
osource "/home/james/repo/zephyr/soc/infineon/cat1a/Kconfig.defconfig"
osource "/home/james/repo/zephyr/soc/gd/gd32/Kconfig.defconfig"
osource "/home/james/repo/zephyr/soc/gaisler/leon3/Kconfig.defconfig"
osource "/home/james/repo/zephyr/soc/gaisler/gr716a/Kconfig.defconfig"
osource "/home/james/repo/zephyr/soc/espressif/Kconfig.defconfig"
osource "/home/james/repo/zephyr/soc/ene/kb1200/Kconfig.defconfig"
osource "/home/james/repo/zephyr/soc/efinix/sapphire/Kconfig.defconfig"
osource "/home/james/repo/zephyr/soc/cdns/xtensa_sample_controller/Kconfig.defconfig"
osource "/home/james/repo/zephyr/soc/cdns/sample_controller32/Kconfig.defconfig"
osource "/home/james/repo/zephyr/soc/cdns/dc233c/Kconfig.defconfig"
osource "/home/james/repo/zephyr/soc/brcm/bcmvk/Kconfig.defconfig"
osource "/home/james/repo/zephyr/soc/brcm/bcm2712/Kconfig.defconfig"
osource "/home/james/repo/zephyr/soc/brcm/bcm2711/Kconfig.defconfig"
osource "/home/james/repo/zephyr/soc/atmel/sam0/Kconfig.defconfig"
osource "/home/james/repo/zephyr/soc/atmel/sam/Kconfig.defconfig"
osource "/home/james/repo/zephyr/soc/aspeed/Kconfig.defconfig"
osource "/home/james/repo/zephyr/soc/arm/Kconfig.defconfig"
osource "/home/james/repo/zephyr/soc/arm/beetle/Kconfig.defconfig"
osource "/home/james/repo/zephyr/soc/antmicro/myra/Kconfig.defconfig"
osource "/home/james/repo/zephyr/soc/andestech/Kconfig.defconfig"
osource "/home/james/repo/zephyr/soc/amd/acp_6_0/Kconfig.defconfig"
osource "/home/james/repo/zephyr/soc/ambiq/Kconfig.defconfig"
osource "/home/james/repo/zephyr/soc/altr/zephyr_nios2f/Kconfig.defconfig"
osource "/home/james/repo/zephyr/soc/altr/qemu_nios2/Kconfig.defconfig"
osource "/home/james/repo/zephyr/soc/adi/max32/Kconfig.defconfig"
```
