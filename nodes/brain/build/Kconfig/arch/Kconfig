## nodes/brain/build/Kconfig/soc/Kconfig.sysbuild
```kconfig
# Load Sysbuild SoC Kconfig descriptions.
osource "/home/james/repo/zephyr/soc/xlnx/zynqmp/Kconfig.sysbuild"
osource "/home/james/repo/zephyr/soc/xlnx/zynq7000/Kconfig.sysbuild"
osource "/home/james/repo/zephyr/soc/xen/Kconfig.sysbuild"
osource "/home/james/repo/zephyr/soc/wch/ch32v/Kconfig.sysbuild"
osource "/home/james/repo/zephyr/soc/ti/simplelink/Kconfig.sysbuild"
osource "/home/james/repo/zephyr/soc/ti/lm3s6965/Kconfig.sysbuild"
osource "/home/james/repo/zephyr/soc/ti/k3/Kconfig.sysbuild"
osource "/home/james/repo/zephyr/soc/telink/tlsr/Kconfig.sysbuild"
osource "/home/james/repo/zephyr/soc/starfive/jh71xx/Kconfig.sysbuild"
osource "/home/james/repo/zephyr/soc/st/stm32/Kconfig.sysbuild"
osource "/home/james/repo/zephyr/soc/snps/qemu_arc/Kconfig.sysbuild"
osource "/home/james/repo/zephyr/soc/snps/nsim/arc_v/Kconfig.sysbuild"
osource "/home/james/repo/zephyr/soc/snps/nsim/arc_classic/Kconfig.sysbuild"
osource "/home/james/repo/zephyr/soc/snps/hsdk4xd/Kconfig.sysbuild"
osource "/home/james/repo/zephyr/soc/snps/hsdk/Kconfig.sysbuild"
osource "/home/james/repo/zephyr/soc/snps/emsk/Kconfig.sysbuild"
osource "/home/james/repo/zephyr/soc/snps/emsdp/Kconfig.sysbuild"
osource "/home/james/repo/zephyr/soc/snps/arc_iot/Kconfig.sysbuild"
osource "/home/james/repo/zephyr/soc/silabs/Kconfig.sysbuild"
osource "/home/james/repo/zephyr/soc/sifive/sifive_freedom/Kconfig.sysbuild"
osource "/home/james/repo/zephyr/soc/sensry/Kconfig.sysbuild"
osource "/home/james/repo/zephyr/soc/rockchip/Kconfig.sysbuild"
osource "/home/james/repo/zephyr/soc/renode/riscv_virtual/Kconfig.sysbuild"
osource "/home/james/repo/zephyr/soc/renode/cortex_r8_virtual/Kconfig.sysbuild"
osource "/home/james/repo/zephyr/soc/renesas/smartbond/Kconfig.sysbuild"
osource "/home/james/repo/zephyr/soc/renesas/rzt2m/Kconfig.sysbuild"
osource "/home/james/repo/zephyr/soc/renesas/rz/Kconfig.sysbuild"
osource "/home/james/repo/zephyr/soc/renesas/rcar/Kconfig.sysbuild"
osource "/home/james/repo/zephyr/soc/renesas/ra/Kconfig.sysbuild"
osource "/home/james/repo/zephyr/soc/realtek/ec/Kconfig.sysbuild"
osource "/home/james/repo/zephyr/soc/raspberrypi/rpi_pico/Kconfig.sysbuild"
osource "/home/james/repo/zephyr/soc/quicklogic/eos_s3/Kconfig.sysbuild"
osource "/home/james/repo/zephyr/soc/qemu/virt_riscv/Kconfig.sysbuild"
osource "/home/james/repo/zephyr/soc/qemu/malta/Kconfig.sysbuild"
osource "/home/james/repo/zephyr/soc/openisa/rv32m1/Kconfig.sysbuild"
osource "/home/james/repo/zephyr/soc/oct/osd32mp15x/Kconfig.sysbuild"
osource "/home/james/repo/zephyr/soc/nxp/s32/Kconfig.sysbuild"
osource "/home/james/repo/zephyr/soc/nxp/rw/Kconfig.sysbuild"
osource "/home/james/repo/zephyr/soc/nxp/mcx/Kconfig.sysbuild"
osource "/home/james/repo/zephyr/soc/nxp/lpc/Kconfig.sysbuild"
osource "/home/james/repo/zephyr/soc/nxp/layerscape/Kconfig.sysbuild"
osource "/home/james/repo/zephyr/soc/nxp/kinetis/Kconfig.sysbuild"
osource "/home/james/repo/zephyr/soc/nxp/imxrt/Kconfig.sysbuild"
osource "/home/james/repo/zephyr/soc/nxp/imx/Kconfig.sysbuild"
osource "/home/james/repo/zephyr/soc/nuvoton/numicro/Kconfig.sysbuild"
osource "/home/james/repo/zephyr/soc/nuvoton/numaker/Kconfig.sysbuild"
osource "/home/james/repo/zephyr/soc/nuvoton/npcx/Kconfig.sysbuild"
osource "/home/james/repo/zephyr/soc/nuvoton/npcm/Kconfig.sysbuild"
osource "/home/james/repo/zephyr/soc/nordic/Kconfig.sysbuild"
osource "/home/james/repo/zephyr/soc/neorv32/Kconfig.sysbuild"
osource "/home/james/repo/zephyr/soc/native/inf_clock/Kconfig.sysbuild"
osource "/home/james/repo/zephyr/soc/microchip/miv/Kconfig.sysbuild"
osource "/home/james/repo/zephyr/soc/microchip/mec/Kconfig.sysbuild"
osource "/home/james/repo/zephyr/soc/mediatek/mt8xxx/Kconfig.sysbuild"
osource "/home/james/repo/zephyr/soc/lowrisc/opentitan/Kconfig.sysbuild"
osource "/home/james/repo/zephyr/soc/litex/litex_vexriscv/Kconfig.sysbuild"
osource "/home/james/repo/zephyr/soc/ite/ec/Kconfig.sysbuild"
osource "/home/james/repo/zephyr/soc/intel/raptor_lake/Kconfig.sysbuild"
osource "/home/james/repo/zephyr/soc/intel/lakemont/Kconfig.sysbuild"
osource "/home/james/repo/zephyr/soc/intel/intel_socfpga_std/Kconfig.sysbuild"
osource "/home/james/repo/zephyr/soc/intel/intel_socfpga/Kconfig.sysbuild"
osource "/home/james/repo/zephyr/soc/intel/intel_niosv/Kconfig.sysbuild"
osource "/home/james/repo/zephyr/soc/intel/intel_ish/Kconfig.sysbuild"
osource "/home/james/repo/zephyr/soc/intel/intel_adsp/Kconfig.sysbuild"
osource "/home/james/repo/zephyr/soc/intel/elkhart_lake/Kconfig.sysbuild"
osource "/home/james/repo/zephyr/soc/intel/atom/Kconfig.sysbuild"
osource "/home/james/repo/zephyr/soc/intel/apollo_lake/Kconfig.sysbuild"
osource "/home/james/repo/zephyr/soc/intel/alder_lake/Kconfig.sysbuild"
osource "/home/james/repo/zephyr/soc/infineon/cat3/Kconfig.sysbuild"
osource "/home/james/repo/zephyr/soc/infineon/cat1b/Kconfig.sysbuild"
osource "/home/james/repo/zephyr/soc/infineon/cat1a/Kconfig.sysbuild"
osource "/home/james/repo/zephyr/soc/gd/gd32/Kconfig.sysbuild"
osource "/home/james/repo/zephyr/soc/gaisler/leon3/Kconfig.sysbuild"
osource "/home/james/repo/zephyr/soc/gaisler/gr716a/Kconfig.sysbuild"
osource "/home/james/repo/zephyr/soc/espressif/Kconfig.sysbuild"
osource "/home/james/repo/zephyr/soc/ene/kb1200/Kconfig.sysbuild"
osource "/home/james/repo/zephyr/soc/efinix/sapphire/Kconfig.sysbuild"
osource "/home/james/repo/zephyr/soc/cdns/xtensa_sample_controller/Kconfig.sysbuild"
osource "/home/james/repo/zephyr/soc/cdns/sample_controller32/Kconfig.sysbuild"
osource "/home/james/repo/zephyr/soc/cdns/dc233c/Kconfig.sysbuild"
osource "/home/james/repo/zephyr/soc/brcm/bcmvk/Kconfig.sysbuild"
osource "/home/james/repo/zephyr/soc/brcm/bcm2712/Kconfig.sysbuild"
osource "/home/james/repo/zephyr/soc/brcm/bcm2711/Kconfig.sysbuild"
osource "/home/james/repo/zephyr/soc/atmel/sam0/Kconfig.sysbuild"
osource "/home/james/repo/zephyr/soc/atmel/sam/Kconfig.sysbuild"
osource "/home/james/repo/zephyr/soc/aspeed/Kconfig.sysbuild"
osource "/home/james/repo/zephyr/soc/arm/Kconfig.sysbuild"
osource "/home/james/repo/zephyr/soc/arm/beetle/Kconfig.sysbuild"
osource "/home/james/repo/zephyr/soc/antmicro/myra/Kconfig.sysbuild"
osource "/home/james/repo/zephyr/soc/andestech/Kconfig.sysbuild"
osource "/home/james/repo/zephyr/soc/amd/acp_6_0/Kconfig.sysbuild"
osource "/home/james/repo/zephyr/soc/ambiq/Kconfig.sysbuild"
osource "/home/james/repo/zephyr/soc/altr/zephyr_nios2f/Kconfig.sysbuild"
osource "/home/james/repo/zephyr/soc/altr/qemu_nios2/Kconfig.sysbuild"
osource "/home/james/repo/zephyr/soc/adi/max32/Kconfig.sysbuild"
```

## reference_code/niall/GATTstuff/board_peripheral/build/Kconfig/Kconfig.modules
```kconfig
menu "acpica (/home/james/repo/modules/lib/acpica)"
osource "$(ZEPHYR_ACPICA_KCONFIG)"
config ZEPHYR_ACPICA_MODULE
	bool
	default y
endmenu
menu "cmsis (/home/james/repo/modules/hal/cmsis)"
osource "$(ZEPHYR_CMSIS_KCONFIG)"
config ZEPHYR_CMSIS_MODULE
	bool
	default y
endmenu
menu "cmsis-dsp (/home/james/repo/modules/lib/cmsis-dsp)"
osource "$(ZEPHYR_CMSIS_DSP_KCONFIG)"
config ZEPHYR_CMSIS_DSP_MODULE
	bool
	default y
endmenu
menu "cmsis-nn (/home/james/repo/modules/lib/cmsis-nn)"
osource "$(ZEPHYR_CMSIS_NN_KCONFIG)"
config ZEPHYR_CMSIS_NN_MODULE
	bool
	default y
endmenu
menu "fatfs (/home/james/repo/modules/fs/fatfs)"
osource "$(ZEPHYR_FATFS_KCONFIG)"
config ZEPHYR_FATFS_MODULE
	bool
	default y
endmenu
config ZEPHYR_ADI_MODULE
	bool
	default y
config ZEPHYR_ALTERA_MODULE
	bool
	default y
menu "hal_ambiq (/home/james/repo/modules/hal/ambiq)"
osource "$(ZEPHYR_HAL_AMBIQ_KCONFIG)"
config ZEPHYR_HAL_AMBIQ_MODULE
	bool
	default y
endmenu
config ZEPHYR_ATMEL_MODULE
	bool
	default y
menu "hal_espressif (/home/james/repo/modules/hal/espressif)"
osource "/home/james/repo/modules/hal/espressif/zephyr/Kconfig"
config ZEPHYR_HAL_ESPRESSIF_MODULE
	bool
	default y

config ZEPHYR_HAL_ESPRESSIF_MODULE_BLOBS
	bool
endmenu
menu "hal_ethos_u (/home/james/repo/modules/hal/ethos_u)"
osource "$(ZEPHYR_HAL_ETHOS_U_KCONFIG)"
config ZEPHYR_HAL_ETHOS_U_MODULE
	bool
	default y
endmenu
menu "hal_gigadevice (/home/james/repo/modules/hal/gigadevice)"
osource "$(ZEPHYR_HAL_GIGADEVICE_KCONFIG)"
config ZEPHYR_HAL_GIGADEVICE_MODULE
	bool
	default y
endmenu
menu "hal_infineon (/home/james/repo/modules/hal/infineon)"
osource "$(ZEPHYR_HAL_INFINEON_KCONFIG)"
config ZEPHYR_HAL_INFINEON_MODULE
	bool
	default y

config ZEPHYR_HAL_INFINEON_MODULE_BLOBS
	bool
endmenu
menu "hal_intel (/home/james/repo/modules/hal/intel)"
osource "/home/james/repo/modules/hal/intel/zephyr/Kconfig"
config ZEPHYR_HAL_INTEL_MODULE
	bool
	default y
endmenu
config ZEPHYR_MICROCHIP_MODULE
	bool
	default y
menu "hal_nordic (/home/james/repo/modules/hal/nordic)"
osource "$(ZEPHYR_HAL_NORDIC_KCONFIG)"
config ZEPHYR_HAL_NORDIC_MODULE
	bool
	default y

config ZEPHYR_HAL_NORDIC_MODULE_BLOBS
	bool
endmenu
config ZEPHYR_NUVOTON_MODULE
	bool
	default y
menu "hal_nxp (/home/james/repo/modules/hal/nxp)"
osource "$(ZEPHYR_HAL_NXP_KCONFIG)"
config ZEPHYR_HAL_NXP_MODULE
	bool
	default y

config ZEPHYR_HAL_NXP_MODULE_BLOBS
	bool
endmenu
config ZEPHYR_OPENISA_MODULE
	bool
	default y
config ZEPHYR_QUICKLOGIC_MODULE
	bool
	default y
config ZEPHYR_HAL_RENESAS_MODULE
	bool
	default y

config ZEPHYR_HAL_RENESAS_MODULE_BLOBS
	bool
menu "hal_rpi_pico (/home/james/repo/modules/hal/rpi_pico)"
osource "$(ZEPHYR_HAL_RPI_PICO_KCONFIG)"
config ZEPHYR_HAL_RPI_PICO_MODULE
	bool
	default y
endmenu
menu "hal_silabs (/home/james/repo/modules/hal/silabs)"
osource "$(ZEPHYR_HAL_SILABS_KCONFIG)"
config ZEPHYR_HAL_SILABS_MODULE
	bool
	default y

config ZEPHYR_HAL_SILABS_MODULE_BLOBS
	bool
endmenu
menu "hal_st (/home/james/repo/modules/hal/st)"
osource "$(ZEPHYR_HAL_ST_KCONFIG)"
config ZEPHYR_HAL_ST_MODULE
	bool
	default y
endmenu
config ZEPHYR_HAL_STM32_MODULE
	bool
	default y

config ZEPHYR_HAL_STM32_MODULE_BLOBS
	bool
menu "hal_tdk (/home/james/repo/modules/hal/tdk)"
osource "$(ZEPHYR_HAL_TDK_KCONFIG)"
config ZEPHYR_HAL_TDK_MODULE
	bool
	default y
endmenu
menu "hal_telink (/home/james/repo/modules/hal/telink)"
osource "/home/james/repo/modules/hal/telink/Kconfig"
config ZEPHYR_HAL_TELINK_MODULE
	bool
	default y
endmenu
config ZEPHYR_TI_MODULE
	bool
	default y
menu "hal_wch (/home/james/repo/modules/hal/wch)"
osource "$(ZEPHYR_HAL_WCH_KCONFIG)"
config ZEPHYR_HAL_WCH_MODULE
	bool
	default y
endmenu
config ZEPHYR_HAL_WURTHELEKTRONIK_MODULE
	bool
	default y
config ZEPHYR_XTENSA_MODULE
	bool
	default y
menu "hostap (/home/james/repo/modules/lib/hostap)"
osource "$(ZEPHYR_HOSTAP_KCONFIG)"
config ZEPHYR_HOSTAP_MODULE
	bool
	default y
endmenu
menu "liblc3 (/home/james/repo/modules/lib/liblc3)"
osource "$(ZEPHYR_LIBLC3_KCONFIG)"
config ZEPHYR_LIBLC3_MODULE
	bool
	default y
endmenu
config ZEPHYR_LIBMCTP_MODULE
	bool
	default y
config ZEPHYR_LIBMETAL_MODULE
	bool
	default y
menu "littlefs (/home/james/repo/modules/fs/littlefs)"
osource "$(ZEPHYR_LITTLEFS_KCONFIG)"
config ZEPHYR_LITTLEFS_MODULE
	bool
	default y
endmenu
menu "loramac-node (/home/james/repo/modules/lib/loramac-node)"
osource "$(ZEPHYR_LORAMAC_NODE_KCONFIG)"
config ZEPHYR_LORAMAC_NODE_MODULE
	bool
	default y
endmenu
menu "lvgl (/home/james/repo/modules/lib/gui/lvgl)"
osource "/home/james/repo/modules/lib/gui/lvgl/zephyr/Kconfig"
config ZEPHYR_LVGL_MODULE
	bool
	default y
endmenu
menu "mbedtls (/home/james/repo/modules/crypto/mbedtls)"
osource "$(ZEPHYR_MBEDTLS_KCONFIG)"
config ZEPHYR_MBEDTLS_MODULE
	bool
	default y
endmenu
config ZEPHYR_MCUBOOT_MODULE
	bool
	default y
config ZEPHYR_MIPI_SYS_T_MODULE
	bool
	default y
menu "nrf_wifi (/home/james/repo/modules/lib/nrf_wifi)"
osource "$(ZEPHYR_NRF_WIFI_KCONFIG)"
config ZEPHYR_NRF_WIFI_MODULE
	bool
	default y

config ZEPHYR_NRF_WIFI_MODULE_BLOBS
	bool
endmenu
config ZEPHYR_OPEN_AMP_MODULE
	bool
	default y
menu "openthread (/home/james/repo/modules/lib/openthread)"
osource "$(ZEPHYR_OPENTHREAD_KCONFIG)"
config ZEPHYR_OPENTHREAD_MODULE
	bool
	default y
endmenu
menu "percepio (/home/james/repo/modules/debug/percepio)"
osource "/home/james/repo/modules/debug/percepio/zephyr/Kconfig"
config ZEPHYR_PERCEPIO_MODULE
	bool
	default y
endmenu
menu "picolibc (/home/james/repo/modules/lib/picolibc)"
osource "/home/james/repo/modules/lib/picolibc/zephyr/Kconfig"
config ZEPHYR_PICOLIBC_MODULE
	bool
	default y
endmenu
menu "segger (/home/james/repo/modules/debug/segger)"
osource "$(ZEPHYR_SEGGER_KCONFIG)"
config ZEPHYR_SEGGER_MODULE
	bool
	default y
endmenu
config ZEPHYR_TINYCRYPT_MODULE
	bool
	default y
menu "trusted-firmware-a (/home/james/repo/modules/tee/tf-a/trusted-firmware-a)"
osource "$(ZEPHYR_TRUSTED_FIRMWARE_A_KCONFIG)"
config ZEPHYR_TRUSTED_FIRMWARE_A_MODULE
	bool
	default y
endmenu
menu "trusted-firmware-m (/home/james/repo/modules/tee/tf-m/trusted-firmware-m)"
osource "$(ZEPHYR_TRUSTED_FIRMWARE_M_KCONFIG)"
config ZEPHYR_TRUSTED_FIRMWARE_M_MODULE
	bool
	default y
endmenu
menu "uoscore-uedhoc (/home/james/repo/modules/lib/uoscore-uedhoc)"
osource "$(ZEPHYR_UOSCORE_UEDHOC_KCONFIG)"
config ZEPHYR_UOSCORE_UEDHOC_MODULE
	bool
	default y
endmenu
menu "zcbor (/home/james/repo/modules/lib/zcbor)"
osource "$(ZEPHYR_ZCBOR_KCONFIG)"
config ZEPHYR_ZCBOR_MODULE
	bool
	default y
endmenu
config ZEPHYR_NRF_HW_MODELS_MODULE
	bool
	default y
```

## reference_code/niall/GATTstuff/board_peripheral/build/Kconfig/boards/Kconfig.defconfig
```kconfig
# Load Zephyr board defconfig descriptions.
osource "/home/james/repo/zephyr/boards/nordic/nrf52840dk/Kconfig.defconfig"
```

## reference_code/niall/p2/t1/mylib_clock/Kconfig
```kconfig
# Sets a new .config variable "CONFIGURE_MYLIB_RTCC".
menuconfig MYLIB_CLOCK
    bool "Enable real time clock Library"
    default n
    help
      Enable the real time clock support library

# When "CONFIGURE_MYLIB_CLOCK" is set 
# it will also activate all of the other
# configs required for this library.
if MYLIB_CLOCK

    config SHELL
        default y

    config LOG
        default y

    config RTC
        default y

    config COUNTER
        default y

    config COUNTER_GECKO_RTCC
        default y

endif
```

## reference_code/niall/p2/t2/mylib_sensors/Kconfig
```kconfig
# Sets a new .config variable "CONFIGURE_MYLIB_RTCC".
menuconfig MYLIB_SENSORS
    bool "Enable Sensor Library"
    default n
    help
      Enable the sensor support library

# When "CONFIGURE_MYLIB_SENSORS" is set 
# it will also activate all of the other
# configs required for this library.
if MYLIB_SENSORS

    config SHELL
        default y

    config SENSOR
        default y

    config LOG
        default y

    # config SENSOR_LOG_LEVEL
    #     default 4

    config SENSOR_ASYNC_API
        default y

    config HW_STACK_PROTECTION
        default y

    config I2C
        default y

endif
```

## reference_code/niall/p2/t3/mylib_shell/Kconfig
```kconfig
# Sets a new .config variable "CONFIGURE_MYLIB_SHELL".
menuconfig MYLIB_SHELL
    bool "Enable shell library module."
    default n
    help
      Enable shell library module.

# When "CONFIGURE_MYLIB_SHELL" is set 
# it will also activate all of the other
# configs required for this library.
if MYLIB_SHELL

    config SHELL
        default y

endif
```

## reference_code/niall/p2/t4/mylib_sampling/Kconfig
```kconfig
# Sets a new .config variable "CONFIGURE_MYLIB_SAMPLING".
menuconfig MYLIB_SAMPLING
    bool "Enable shell library module."
    default n
    help
      Enable shell library module.

# When "MYLIB_SAMPLINGL" is set 
# it will also activate all of the other
# configs required for this library:
if MYLIB_SAMPLING

    config SHELL
        default y

    config JSON_LIBRARY
        default y

    # This allows k_malloc to be used and defines a memory pool for it.
    config HEAP_MEM_POOL_SIZE
        default 2048

endif
```
