## CMakeLists.txt
```
# SPDX-License-Identifier: Apache-2.0

cmake_minimum_required(VERSION 3.20.0)

find_package(Zephyr REQUIRED HINTS $ENV{ZEPHYR_BASE})
project(sense_human)

FILE(GLOB sources src/*.c)
target_sources(app PRIVATE ${sources})

target_include_directories(app PRIVATE include)
```

## prj.conf
```kconfig
# Allows memory allocation (malloc).
CONFIG_HEAP_MEM_POOL_SIZE=1024

# Allows logging.
CONFIG_LOG=y

CONFIG_COUNTER=y

CONFIG_PRINTK=y
CONFIG_GPIO=y

CONFIG_TICKLESS_KERNEL=y
CONFIG_LOG=y
CONFIG_LOG_CMDS=y
CONFIG_LOG_RUNTIME_FILTERING=y

CONFIG_STDOUT_CONSOLE=y
CONFIG_I2C=y
CONFIG_SENSOR=y

CONFIG_RTT_CONSOLE=y
CONFIG_USE_SEGGER_RTT=y
CONFIG_CBPRINTF_FP_SUPPORT=y

CONFIG_BT=y
CONFIG_BT_BROADCASTER=y
```

## src/main.c
```c
#include "new_sensor_lib.h"
#include "bluetooth_thingy.h"

#define MY_STACK_SIZE 1024
#define COMMON_PRIORITY 4

K_THREAD_DEFINE(voc_tid, MY_STACK_SIZE * 4,  sender_thread_thingy, NULL, NULL, NULL, COMMON_PRIORITY, 0, 0);



int main(void) {
    bluetooth_init_thingy();
    printf("done!\n");
    return 0;
}
```

## include/bluetooth_thingy.h
```c
#ifndef BLUETOOTH_VOC
#define BLUETOOTH_VOC

extern void sender_thread_thingy(void);
extern void bluetooth_init_thingy(void); 

#endif
```

## include/led_lib.h
```c
#ifndef LEDS
#define LEDS

#include <zephyr/kernel.h>
#include <zephyr/device.h>
#include <zephyr/drivers/gpio.h>
#include <stdlib.h>
#include <stdio.h>
#include <zephyr/drivers/led.h>

extern void set_colour(int r, int g, int b);

#endif
```

## include/new_sensor_lib.h
```c
#ifndef SENSORS_NEW
#define SENSORS_NEW

#include <zephyr/kernel.h>
#include <zephyr/device.h>
#include <zephyr/drivers/gpio.h>
#include <zephyr/sys/printk.h>
#include <string.h>
#include <stdlib.h>
#include <stdio.h>
#include <zephyr/drivers/sensor.h>
#include <zephyr/sys/util.h>
#include <zephyr/sys/spsc_pbuf.h>
#include <zephyr/shell/shell.h>
#include <zephyr/drivers/sensor/ccs811.h>
#include <zephyr/data/json.h>

extern const struct device *const gas;
extern void gas_read_thread(void);

extern double convert_and_collect(const struct device * dev, enum sensor_channel chan);
#endif
```

## src/bluetooth_thingy.c
```c
#include <zephyr/kernel.h>
#include <zephyr/bluetooth/bluetooth.h>
#include <zephyr/logging/log.h>
#include <string.h>
#include <zephyr/device.h>
#include <zephyr/drivers/gpio.h>
#include <zephyr/sys/printk.h>
#include <zephyr/sys/util.h>
#include <zephyr/bluetooth/hci.h>
#include "new_sensor_lib.h"
#include "led_lib.h"

#define IBEACON_RSSI 0xFF
#define NAME_LEN 30

static struct bt_data default_ad[] = {
    BT_DATA_BYTES(BT_DATA_FLAGS, BT_LE_AD_NO_BREDR),
    BT_DATA_BYTES(BT_DATA_MANUFACTURER_DATA,
              0x4c, 0x00, /* Apple */
              0x02, 0x15, /* iBeacon */
              0x00, 0x00, 0x00, 0x00, /* UUID[15..12] */
              0x00, 0x00, /* UUID  [11..10] */
              0x00, 0x00, /* UUID[9..8] */
              0x00, 0x00, /* UUID[7..6] */
              0x00, 0x00, 0x00, 0x00, 0x00, 0x00, /* UUID[5..0] */
              0x00, 0x00, /* Major - will be updated */
              0x00, 0x00, /* Minor - will be updated with distance */
              IBEACON_RSSI) /* Calibrated RSSI @ 1m */
};

static void start_advertising_thingy(void) { 
    printk("shall we start?\n");   
    struct bt_le_adv_param param = {
        .options = BT_LE_ADV_OPT_USE_IDENTITY | BT_LE_ADV_OPT_CONNECTABLE,
        .interval_min = BT_GAP_ADV_FAST_INT_MIN_2,
        .interval_max = BT_GAP_ADV_FAST_INT_MAX_2,
        .id = 0, 
    };
    
    
    bt_le_adv_start(&param, default_ad, ARRAY_SIZE(default_ad), NULL, 0);
    printk("yes we shall!\n");

    while (1) {
        uint32_t voc = convert_and_collect(gas, SENSOR_CHAN_VOC);
        if (voc > 250) {
            set_colour(1, 0, 1);
        } else {
            set_colour(1, 1, 1);
        }
        struct bt_data dynamic_ad[] = {
            BT_DATA_BYTES(BT_DATA_FLAGS, BT_LE_AD_NO_BREDR),
            BT_DATA_BYTES(BT_DATA_MANUFACTURER_DATA,
            0x4c, 0x00, /* Apple */
            0x02, 0x15, /* iBeacon */
            0x00, 0x00, 0x00, 0x00, /* UUID[15..12] */
            0x00, 0x00, /* UUID  [11..10] */
            0x00, 0x00, /* UUID[9..8] */
            0x00, 0x00, /* UUID[7..6] */
            0x00, 0x00, 0x00, 0x00, 0x00, 0x00, /* UUID[5..0] */
            ((voc >> 8) & 0xFF), (voc & 0xFF), /* Major - will be updated */
            ((0 >> 8) & 0xFF), (0 & 0xFF), /* Minor - will be updated with distance */
            voc) /* Calibrated RSSI @ 1m */
        };
        printk("gas: %d\n", voc);
        bt_le_adv_update_data(dynamic_ad, ARRAY_SIZE(dynamic_ad), NULL, 0);
        k_msleep(1000);
    }
}

void sender_thread_thingy(void) {
    printf("gonna try :)\n");
    k_sleep(K_MSEC(3000));
    start_advertising_thingy();
    printf("adv started!!!!!\n");
}

void bluetooth_init_thingy(void) {
    k_sleep(K_MSEC(3000));
  bt_addr_le_t mobile_addr;
  printf("1: %d\n", bt_addr_le_from_str("DA:FF:AA:FF:AA:FF", "random", &mobile_addr));
  printf("2: %d\n", bt_id_create(&mobile_addr, NULL));
  printf("3: %d\n", bt_enable(NULL));
  printf("hiya\n");
}
```

## src/led_lib.c
```c
#include "led_lib.h"
#include "new_sensor_lib.h"

struct s_data_a {
	void *fifo_reserved; /* 1st word reserved for use by fifo */
	double value;
    char* sensor;
};

#define LED0_NODE DT_ALIAS(led0)
#define LED1_NODE DT_ALIAS(led1)
#define LED2_NODE DT_ALIAS(led2)

#if !DT_NODE_HAS_STATUS_OKAY(LED0_NODE)
#error "Unsupported board: led0 devicetree alias is not defined"
#endif

#if !DT_NODE_HAS_STATUS_OKAY(LED1_NODE)
#error "Unsupported board: led1 devicetree alias is not defined"
#endif

#if !DT_NODE_HAS_STATUS_OKAY(LED2_NODE)
#error "Unsupported board: led2 devicetree alias is not defined"
#endif

static const struct gpio_dt_spec led0 = GPIO_DT_SPEC_GET(LED0_NODE, gpios);
static const struct gpio_dt_spec led1 = GPIO_DT_SPEC_GET(LED1_NODE, gpios);
static const struct gpio_dt_spec led2 = GPIO_DT_SPEC_GET(LED2_NODE, gpios);

void set_colour(int r, int g, int b) {
    gpio_pin_set_dt(&led0, r);
    gpio_pin_set_dt(&led1, g);
    gpio_pin_set_dt(&led2, b);
}
```

## src/new_sensor_lib.c
```c
#include "new_sensor_lib.h"

const struct device *const gas = DEVICE_DT_GET_ONE(ams_ccs811);

double convert_and_collect(const struct device * dev, enum sensor_channel chan);

struct s_data {
	void *lifo_reserved; /* 1st word reserved for use by lifo */
	double value;
    char* sensor;
    double all[4];
};

struct sensor_values {
    int did;
    char* time;
    char* *values;
    int count;
};

double convert_and_collect(const struct device * dev, enum sensor_channel chan) {
    struct sensor_value s;
    if (sensor_sample_fetch(dev) < 0) {
		return -1;
	}

    if (sensor_channel_get(dev, chan, &s) < 0) {
        return -1;
    }
    double val = sensor_value_to_double(&s);
    return val;
}
```
